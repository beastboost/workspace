## Kconfig.projbuild
```kconfig
menu "GBA Emulator Configuration"

    config GBA_ENABLE_AUDIO
        bool "Enable audio output"
        default y
        help
            Enable audio emulation and output via I2S.
            Disabling audio can improve performance.

    config GBA_AUDIO_SAMPLE_RATE
        int "Audio sample rate (Hz)"
        default 32768
        depends on GBA_ENABLE_AUDIO
        help
            Audio output sample rate. Lower values use less CPU
            but have lower quality.

    config GBA_FRAMESKIP
        int "Frame skip (0=disabled)"
        default 0
        range 0 10
        help
            Number of frames to skip between rendered frames.
            Higher values improve performance but reduce smoothness.
            0 = render every frame

    config GBA_SHOW_FPS
        bool "Show FPS counter"
        default y
        help
            Display frames per second in the serial output.

    menu "Display Configuration"
        config GBA_LCD_WIDTH
            int "LCD width"
            default 320

        config GBA_LCD_HEIGHT
            int "LCD height"
            default 240

        config GBA_LCD_PIXEL_CLOCK_MHZ
            int "LCD pixel clock (MHz)"
            default 16

        config GBA_LCD_BACKLIGHT_PIN
            int "Backlight GPIO pin"
            default 1
    endmenu

    menu "Input Configuration"
        config GBA_INPUT_A_PIN
            int "Button A GPIO"
            default 4

        config GBA_INPUT_B_PIN
            int "Button B GPIO"
            default 5

        config GBA_INPUT_SELECT_PIN
            int "Button SELECT GPIO"
            default 6

        config GBA_INPUT_START_PIN
            int "Button START GPIO"
            default 7

        config GBA_INPUT_UP_PIN
            int "D-Pad UP GPIO"
            default 15

        config GBA_INPUT_DOWN_PIN
            int "D-Pad DOWN GPIO"
            default 16

        config GBA_INPUT_LEFT_PIN
            int "D-Pad LEFT GPIO"
            default 17

        config GBA_INPUT_RIGHT_PIN
            int "D-Pad RIGHT GPIO"
            default 18

        config GBA_INPUT_L_PIN
            int "Button L GPIO"
            default 19

        config GBA_INPUT_R_PIN
            int "Button R GPIO"
            default 20
    endmenu

    menu "SD Card Configuration"
        config GBA_SD_4BIT_MODE
            bool "Use 4-bit SD mode"
            default y
            help
                Use 4-bit SDMMC mode for faster transfers.
                Disable for 1-bit mode if you have wiring issues.

        config GBA_ROM_PATH
            string "ROM directory path"
            default "/sdcard/gba"
            help
                Directory on SD card where ROM files are stored.
    endmenu

endmenu
```

## sdkconfig.defaults
```kconfig
# ESP32-P4 GBA Emulator SDK Configuration Defaults

# Target ESP32-P4
CONFIG_IDF_TARGET="esp32p4"

# CPU Frequency - Max performance
CONFIG_ESP_DEFAULT_CPU_FREQ_MHZ_400=y
CONFIG_ESP_DEFAULT_CPU_FREQ_MHZ=400

# Memory Configuration
CONFIG_ESP32P4_SPIRAM_SUPPORT=y
CONFIG_SPIRAM=y
CONFIG_SPIRAM_MODE_OCT=y
CONFIG_SPIRAM_SPEED_80M=y
CONFIG_SPIRAM_BOOT_INIT=y
CONFIG_SPIRAM_USE_MALLOC=y
CONFIG_SPIRAM_MALLOC_ALWAYSINTERNAL=4096
CONFIG_SPIRAM_MALLOC_RESERVE_INTERNAL=32768

# Flash Configuration
CONFIG_ESPTOOLPY_FLASHSIZE_16MB=y
CONFIG_ESPTOOLPY_FLASHSIZE="16MB"
CONFIG_ESPTOOLPY_FLASHMODE_QIO=y
CONFIG_ESPTOOLPY_FLASHFREQ_80M=y

# Partition Table
CONFIG_PARTITION_TABLE_CUSTOM=y
CONFIG_PARTITION_TABLE_CUSTOM_FILENAME="partitions.csv"

# FreeRTOS Configuration
CONFIG_FREERTOS_HZ=1000
CONFIG_FREERTOS_UNICORE=n
CONFIG_FREERTOS_TIMER_TASK_STACK_DEPTH=4096

# Task Watchdog
CONFIG_ESP_TASK_WDT_TIMEOUT_S=10
CONFIG_ESP_TASK_WDT_CHECK_IDLE_TASK_CPU0=n
CONFIG_ESP_TASK_WDT_CHECK_IDLE_TASK_CPU1=n

# Compiler Optimization
CONFIG_COMPILER_OPTIMIZATION_PERF=y
CONFIG_COMPILER_OPTIMIZATION_ASSERTIONS_SILENT=y

# Stack Protection (disable for performance)
CONFIG_COMPILER_STACK_CHECK_MODE_NONE=y

# Logging (reduce for performance)
CONFIG_LOG_DEFAULT_LEVEL_WARN=y
CONFIG_LOG_DEFAULT_LEVEL=2

# SD/MMC Configuration
CONFIG_SOC_SDMMC_HOST_SUPPORTED=y

# LCD/Display Configuration
CONFIG_LCD_RGB_ISR_IRAM_SAFE=y

# USB OTG (for potential controller support)
CONFIG_USB_OTG_SUPPORTED=y
```
